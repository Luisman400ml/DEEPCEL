`timescale 1ns / 1ps

module eco_nn_top_Tb;
    reg clk = 1'b0;
    reg reset = 1'b0;
    reg data_ready = 1'b0;
    reg [15:0] sensor_in = 16'd0;
    wire [15:0] prediction;
    integer failures = 0;

    eco_nn_top UUT (
        .clk(clk),
        .reset(reset),
        .sensor_in(sensor_in),
        .data_ready(data_ready),
        .prediction(prediction)
    );

    // 24 MHz low-power neural-network clock.
    always #20.833 clk = ~clk;

    task push_sample(input [15:0] sample);
        begin
            sensor_in = sample;
            #100;
            // Match the 1 us pulse generated by the SAMD21 firmware.
            data_ready = 1'b1;
            #1000;
            data_ready = 1'b0;
            #500;
        end
    endtask

    task check_window(
        input [15:0] expected0,
        input [15:0] expected1,
        input [15:0] expected2,
        input [15:0] expected3
    );
        begin
            if (UUT.window[0] !== expected0 || UUT.window[1] !== expected1 ||
                UUT.window[2] !== expected2 || UUT.window[3] !== expected3) begin
                failures = failures + 1;
                $display("WINDOW FAIL got=%h,%h,%h,%h expected=%h,%h,%h,%h",
                    UUT.window[0], UUT.window[1], UUT.window[2], UUT.window[3],
                    expected0, expected1, expected2, expected3);
            end
        end
    endtask

    initial begin
        #250;
        reset = 1'b1;
        #250;

        push_sample(16'h1900); // 25.00 C
        check_window(16'h0000, 16'h0000, 16'h0000, 16'h1900);
        push_sample(16'h190F); // 25.06 C
        check_window(16'h0000, 16'h0000, 16'h1900, 16'h190F);
        push_sample(16'h191F); // 25.12 C
        check_window(16'h0000, 16'h1900, 16'h190F, 16'h191F);
        push_sample(16'h192E); // 25.18 C
        check_window(16'h1900, 16'h190F, 16'h191F, 16'h192E);

        // The original model test vector expects 6438 / 256 = 25.148 C.
        if (prediction !== 16'd6438) begin
            failures = failures + 1;
            $display("PREDICTION FAIL got=%0d expected=6438", prediction);
        end

        push_sample(16'h193D); // 25.24 C
        check_window(16'h190F, 16'h191F, 16'h192E, 16'h193D);

        if (failures == 0)
            $display("WINDOW SELFTEST PASS");
        else
            $display("WINDOW SELFTEST FAIL failures=%0d", failures);
        $finish;
    end
endmodule
